/*************************************************************************************************/
/*文件：RGB IC SK9822配置C文件			                                                             */
/*记录：By Zouqb@2022.3.18																																			 */
/*************************************************************************************************/
#include "SK9822.h"
#include "SPI.h"

TYPE_SK9822 SK9822 = {0};//SK9822_DEF;

/*************************************************************************************************/
/* 功能：初始化配置																																	 	             */
/* 输入：无                                                                                      */
/* 输出：无                                                                                      */
/* 描述：1、配置引脚                                */
/*       2、配置SK9822全局设置                                                       */
/*************************************************************************************************/
void SK9822_Init(void)
{
		//== 0.初始化SPI1 DMA传输
		SPI1_Init();
		
		//== 1.每个子LED都需要初始化电流配置
		for(Uint8 Num = 0; Num < RGB_NUM;	Num++)
		{
				SK9822.LED[Num].H.bit.rsvd = 0x7;
				SK9822.LED[Num].H.bit.Iout = 0x9;	//== 推荐最大电流
				SK9822.LED[Num].R = 0x00;
				SK9822.LED[Num].G = 0x10;
				SK9822.LED[Num].B = 0x00;
		}
		SK9822.Head = 0x00000000;
		SK9822.Tail	= 0xFFFFFFFF;
		
		//== 2.指针映射，方便RGB数据传递
		for(Uint8 Num = 0; Num < RGB_NUM;	Num++)
		{
				SK9822.pLED[RGB_NUM-1-Num][0] = (Uint8 *)&SK9822.LED[Num].R;
				SK9822.pLED[RGB_NUM-1-Num][1] = (Uint8 *)&SK9822.LED[Num].G;
				SK9822.pLED[RGB_NUM-1-Num][2] = (Uint8 *)&SK9822.LED[Num].B;
		}
}

/*************************************************************************************************/
/* 功能：IC接口																										 	     					 	 */
/* 输入：无                                                                                      */
/* 输出：无                                                                                      */
/* 描述：LED刷新 DMA              */
/*************************************************************************************************/
void SK9822_Update_DMA(Uint8 *pRGB)
{
		//== 0.数据传递
		for(Uint8 Num = 0; Num < RGB_NUM*3;	Num++)
		{
				*SK9822.pLED[0][Num] = *pRGB++;
		}

		//== 1. 数据DMA传输：帧头(4Bytes)+ICs*帧数据(4Bytes)+帧尾(4Bytes)
		SPI1_TX_START((Uint16 *)&SK9822.Head, (4+RGB_NUM*4+4));
		
}
